## firmware/brookesia/components/Settings/Kconfig
```kconfig
menu "Settings Application"

    config SETTINGS_UI_ROUND_DISPLAY
        bool "Lay out the Settings UI for a round display"
        default y
        help
            Enable on boards with a circular panel, such as the XC 3.4C
            (800x800) and 4C (720x720). Headers, buttons and lists are then
            kept inside the visible circle. Disable on rectangular or square
            panels to get the plain rectangular layout.

endmenu
```

## firmware/brookesia/components/XiaozhiApp/Kconfig
```kconfig
menu "Xiaozhi Application"

    choice XIAOZHI_APP_UI_LANGUAGE
        prompt "Local UI language"
        default XIAOZHI_APP_UI_LANGUAGE_ENGLISH
        help
            Select the compile-time language used for local Xiaozhi status
            text and fallback activation instructions. Conversation text and
            activation messages received from the server are shown unchanged.

        config XIAOZHI_APP_UI_LANGUAGE_ENGLISH
            bool "English"

        config XIAOZHI_APP_UI_LANGUAGE_SIMPLIFIED_CHINESE
            bool "Simplified Chinese"
    endchoice

    choice XIAOZHI_APP_TRANSPORT
        prompt "Preferred Xiaozhi transport"
        default XIAOZHI_APP_TRANSPORT_WEBSOCKET
        help
            WebSocket matches the previously validated factory-firmware path.
            Auto allows esp_xiaozhi to prefer MQTT+UDP when both transports
            are supplied by the server.

        config XIAOZHI_APP_TRANSPORT_WEBSOCKET
            bool "WebSocket"

        config XIAOZHI_APP_TRANSPORT_AUTO
            bool "Auto (prefer MQTT+UDP)"

        config XIAOZHI_APP_TRANSPORT_MQTT
            bool "MQTT+UDP"
    endchoice

    config XIAOZHI_APP_ROUND_DISPLAY
        bool "Lay out the Xiaozhi UI for a round display"
        default y
        help
            Enable on boards with a circular panel, such as the XC 3.4C
            (800x800) and 4C (720x720). The status bar is moved down to where
            the circle is wide enough, and the status, subtitle and activation
            areas are narrowed to the visible circle. Only applies when the
            panel is square.

endmenu
```

## firmware/brookesia/components/brookesia_app_calculator/Kconfig
```kconfig
menu "Calculator Application"

    config BROOKESIA_APP_CALCULATOR_ROUND_DISPLAY
        bool "Lay out the Calculator for a round display"
        default y
        help
            Enable on boards with a circular panel, such as the XC 3.4C
            (800x800) and 4C (720x720). The display and the round keys are
            then sized to stay inside the visible circle. Only applies when
            the panel is square; disable on rectangular panels to keep the
            plain rectangular layout.

endmenu
```
